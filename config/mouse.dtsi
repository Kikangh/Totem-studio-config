// ZMK v0.3 : les macros ont été renommées ZMK_POINTING_* (les anciennes ZMK_MOUSE_* sont ignorées -> défaut 600 / 10)
#define ZMK_POINTING_DEFAULT_MOVE_VAL 2500  // défaut 600 ; ancien essai (non appliqué) : 6000
#define ZMK_POINTING_DEFAULT_SCRL_VAL 40    // défaut 10 ; ancien essai (non appliqué) : 70

#include <dt-bindings/zmk/pointing.h>
#include <behaviors/mouse_keys.dtsi>

&mmv {
    acceleration-exponent = <1>;      // 1
    time-to-max-speed-ms = <300>;     // défaut 300 ; avant : 500
    delay-ms = <0>;                   // 0
};

&msc {
    acceleration-exponent = <1>;      // 0
    time-to-max-speed-ms = <100>;      // 2000
    delay-ms = <0>;                   // 0
};